## qemu/hw/arm/flipper_one/Kconfig
```kconfig
# Copyright (c) 2026, Kara Zajac
# SPDX-License-Identifier: BSD-3-Clause
config FLIPPER_ONE
    bool
    default y
    depends on TCG && AARCH64
    select ARM_V7M
    select UNIMP
    select PL011
    select ARM_GIC
    select SERIAL_MM
    select PL330
    select OR_IRQ
    select SD
    select I2C
    select BITBANG_I2C
    select PCI_EXPRESS_GENERIC_BRIDGE
    select UFS_PCI
    select USB_XHCI_SYSBUS
    select PCI_EXPRESS_DESIGNWARE
    select NVME_PCI
```
